#define CONFIG_WIRELESS
#include <dt-bindings/zmk/outputs.h>
#define ZMK_BASE_LAYER(name, LT, RT, LM, RM, LB, RB, LH, RH)                    \
    ZMK_LAYER(                                                                   \
        name,                                                                    \
        &kp F1    &kp F2 &kp F3 &kp F4 &kp F5               &kp F6 &kp F7 &kp F8 &kp F9 &kp F10   \
        &kp EQUAL &kp N1 &kp N2 &kp N3 &kp N4 &kp N5   &kp N6 &kp N7 &kp N8 &kp N9 &kp N0 &kp MINUS \
        &kp LC(LA(SPACE))    LT                                            RT           &kp BACKSLASH \
        &kp TAB              LM                                            RM           &none         \
        &out OUT_USB         LB &none  &none  &none  &none  &none &none    RB           &none         \
        &none &none &none &none &none                                                               \
        LH                   &lt NAV TAB &lt_num_tab NUM TAB RH                   &kp LEFT &kp DOWN &kp UP &kp RIGHT &none)

#include "zmk-helpers/key-labels/glove80.h"
#include "base.keymap"
