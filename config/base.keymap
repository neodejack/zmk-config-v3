#include <behaviors.dtsi>
#include <dt-bindings/zmk/outputs.h>
#include <zmk-helpers/helper.h> // Requires zmk-helpers module.
#include <dt-bindings/zmk/keys.h>
#ifdef CONFIG_WIRELESS
  #include <dt-bindings/zmk/bt.h>
  #define _BT_SEL_KEYS_                                                        \
      &bt BT_SEL 0 &bt BT_SEL 1 &bt BT_SEL 2 &bt BT_SEL 3 &bt BT_CLR
#else
  #define _BT_SEL_KEYS_ &trans &trans &trans &trans &trans
#endif

#define DEF 0
#define NAV 1
#define FN 2
#define NUM 3
#define SYS 4

#define XXX &none
#define ___ &trans

/* Global settings */

#define QUICK_TAP_MS 175

&sk {
  release-after-ms = <900>;
  quick-release;
};

&sl {
  ignore-modifiers;
};

&lt {
  flavor = "balanced";
  tapping-term-ms = <200>;
  quick-tap-ms = <QUICK_TAP_MS>;
};

/* Homerow mods */

#define KEYS_L LT0 LT1 LT2 LT3 LT4 LM0 LM1 LM2 LM3 LM4 LB0 LB1 LB2 LB3 LB4
#define KEYS_R RT0 RT1 RT2 RT3 RT4 RM0 RM1 RM2 RM3 RM4 RB0 RB1 RB2 RB3 RB4
#ifndef LH2
  #define THUMBS LH1 LH0 RH0 RH1
#else
  #define THUMBS LH2 LH1 LH0 RH0 RH1 RH2
#endif

#define MAKE_HRM(NAME, HOLD, TAP, TRIGGER_POS)                                 \
  ZMK_HOLD_TAP(NAME, flavor = "balanced"; tapping-term-ms = <280>;             \
               quick-tap-ms = <QUICK_TAP_MS>;                                  \
               require-prior-idle-ms = <150>; bindings = <HOLD>, <TAP>;        \
               hold-trigger-key-positions = <TRIGGER_POS>;                     \
               hold-trigger-on-release;)
MAKE_HRM(hml, &kp, &kp, KEYS_R THUMBS)
MAKE_HRM(hmr, &kp, &kp, KEYS_L THUMBS)

MAKE_HRM(hml_repeat, &kp, &key_repeat, KEYS_R THUMBS)
MAKE_HRM(hmr_lpar_lt, &kp, &lpar_lt, KEYS_L THUMBS)
MAKE_HRM(hmr_rpar_gt, &kp, &rpar_gt, KEYS_L THUMBS)

#define MAKE_HRM_HOLD_PREFERRED(NAME, HOLD, TAP)                               \
  ZMK_HOLD_TAP(NAME, flavor = "balanced"; tapping-term-ms = <150>;             \
               require-prior-idle-ms = <150>; bindings = <HOLD>, <TAP>;        \
               hold-trigger-on-release;)

MAKE_HRM_HOLD_PREFERRED(hrm_hp, &kp, &kp)
MAKE_HRM_HOLD_PREFERRED(hrm_hp_colsl, &kp, &colsl)
MAKE_HRM_HOLD_PREFERRED(hrm_hp_eqmark, &kp, &eqmark)

#include "combos.dtsi"

/* Nav cluster */

#define MT_CORE                                                                \
  flavor = "tap-preferred";                                                    \
  tapping-term-ms = <220>;                                                     \
  quick-tap-ms = <220>;                                                        \
  hold-trigger-key-positions = <0>;

&mt { MT_CORE };
ZMK_HOLD_TAP(mt_home, bindings = <&masked_home>, <&kp>; MT_CORE)
ZMK_HOLD_TAP(mt_end, bindings = <&masked_end>, <&kp>; MT_CORE)

#define NAV_LEFT  &mt_home 0   LEFT
#define NAV_RIGHT &mt_end 0    RIGHT
#define NAV_UP    &mt LC(HOME) UP
#define NAV_DOWN  &mt LC(END)  DOWN
#define NAV_BSPC  &mt LC(BSPC) BSPC
#define NAV_DEL   &mt LC(DEL)  DEL

#define MASK_MODS(NAME, MODS, BINDING)                                         \
  ZMK_MOD_MORPH(NAME, bindings = <BINDING>, <BINDING>; mods = <MODS>;)
MASK_MODS(masked_home, (MOD_LCTL), &kp HOME)
MASK_MODS(masked_end,  (MOD_LCTL), &kp END)

/* Caps-word and num-word */

ZMK_MOD_MORPH(smart_shft, bindings = <&sk LSHFT>, <&caps_word>;
              mods = <(MOD_LSFT)>;)
&caps_word {
  /delete-property/ ignore-modifiers;
};

/* Custom behaviors */

ZMK_TRI_STATE(swapper, bindings = <&kt LCTRL>, <&kp TAB>, <&kt LCTRL>;
              ignored-key-positions = <LT4>;)

ZMK_TRI_STATE(app_swapper, bindings = <&kt LGUI>, <&kp TAB>, <&kt LGUI>;
              ignored-key-positions = <LT4>;)

#define SIMPLE_MORPH(NAME, MOD, BINDING1, BINDING2)                            \
  ZMK_MOD_MORPH(NAME, mods = <(MOD_L##MOD | MOD_R##MOD)>;                      \
                bindings = <BINDING1>, <BINDING2>;)

SIMPLE_MORPH(dot_morph, SFT, &kp DOT, &dot_inner_morph)
SIMPLE_MORPH(dot_inner_morph, CTL, &kp COLON, &kp GREATER_THAN)
SIMPLE_MORPH(colsl, SFT, &kp COLON, &kp SEMICOLON)
SIMPLE_MORPH(qexcl, SFT, &kp QMARK, &kp EXCL)
SIMPLE_MORPH(eqmark, SFT, &kp EXCL, &kp QMARK)
SIMPLE_MORPH(lpar_lt, CTL, &kp LPAR, &kp LT)
SIMPLE_MORPH(rpar_gt, CTL, &kp RPAR, &kp GT)
SIMPLE_MORPH(lbkt_lb, CTL, &kp LBKT, &kp LBRC)
SIMPLE_MORPH(rbkt_gb, CTL, &kp RBKT, &kp RBRC)
SIMPLE_MORPH(dope_quotes, SFT, &kp DOUBLE_QUOTES, &kp SINGLE_QUOTE)
SIMPLE_MORPH(gra_tild, CTL, &kp GRAVE, &kp TILDE)
SIMPLE_MORPH(minus_plus, SFT, &kp MINUS, &kp PLUS)
SIMPLE_MORPH(esc_at, SFT, &kp ESC, &kp AT)
SIMPLE_MORPH(pi_per, SFT, &kp PIPE, &kp PRCNT)
SIMPLE_MORPH(back_ha, CTL, &kp BSPC, &kp HASH)
SIMPLE_MORPH(eq_ca, SFT, &kp EQUAL, &kp CARET)
SIMPLE_MORPH(und_dllr, SFT, &kp UNDER, &kp DLLR)
SIMPLE_MORPH(col_fsl, CTL, &kp COLON, &kp FSLH)
SIMPLE_MORPH(fsl_col, SFT, &kp FSLH, &kp COLON)
SIMPLE_MORPH(bsl_scol, CTL, &kp BSLH, &kp SEMICOLON)

ZMK_HOLD_TAP(lt_spc, flavor = "balanced"; tapping-term-ms = <200>;
             quick-tap-ms = <QUICK_TAP_MS>; bindings = <&mo>, <&spc_morph>;)
ZMK_HOLD_TAP(lt_num_tab,
             flavor = "hold-preferred";
             tapping-term-ms = <100>;
             quick-tap-ms = <QUICK_TAP_MS>;
             bindings = <&mo>, <&kp>;
             hold-trigger-key-positions = <KEYS_R>;)
SIMPLE_MORPH(spc_morph, SFT, &kp SPACE, &spotlight)
ZMK_MACRO(spotlight, wait-ms = <0>; tap-ms = <5>; bindings = <&kp LG(SPACE)>;)

ZMK_MOD_MORPH(bs_del, bindings = <&kp BSPC>, <&kp DEL>;
              mods = <(MOD_LSFT | MOD_RSFT)>; keep-mods = <MOD_RSFT>;)

ZMK_TAP_DANCE(copy_cut, tapping-term-ms = <200>;
              bindings = <&kp LC(INS)>, <&kp LC(X)>;)

ZMK_MACRO(win_sleep, wait-ms = <500>; tap-ms = <50>;
          bindings = <&kp LG(X) &kp U &kp S>;)

#define CANCEL    &kp K_CANCEL
#define DSK_PREV  &hmr LCTRL LG(LC(LEFT))
#define DSK_NEXT  &hmr LALT LG(LC(RIGHT))
#define PIN_WIN   &kp LG(LC(LS(Q)))
#define PIN_APP   &kp LG(LC(LS(A)))
#define DSK_MGR   &kp LA(GRAVE)
#define VOL_DOWN  &hmr RSHFT C_VOL_DN
#define HYPER_RET &hrm_hp LC(LA(LS(LGUI))) RET

/* Keymap */

ZMK_CONDITIONAL_LAYER(sys, NAV NUM, SYS)

#ifndef ZMK_BASE_LAYER
  #define ZMK_BASE_LAYER(name, LT, RT, LM, RM, LB, RB, LH, RH)                 \
      ZMK_LAYER(name, LT RT LM RM LB RB LH RH)
#endif

ZMK_BASE_LAYER(base,
//╭─────────────┬─────────────┬─────────────┬─────────────┬─────────────╮ ╭─────────────┬─────────────┬─────────────┬─────────────┬─────────────╮
    &kp B         &kp Y         &kp O         &kp U         &kp Z       ,   &kp Q         &kp L         &kp D         &kp W         &kp V       ,
//├─────────────┼─────────────┼─────────────┼─────────────┼─────────────┤ ├─────────────┼─────────────┼─────────────┼─────────────┼─────────────┤
    &kp C         &kp I         &kp E         &kp A         &hrm_hp LGUI COMMA, &hrm_hp LGUI DOT &kp H &kp T &kp S &kp N ,
//├─────────────┼─────────────┼─────────────┼─────────────┼─────────────┤ ├─────────────┼─────────────┼─────────────┼─────────────┼─────────────┤
    &kp G         &kp X         &kp J         &kp K         &hrm_hp_colsl LALT 0    , &hrm_hp_eqmark LALT 0    &kp R &kp M &kp F &kp P ,
//╰─────────────┼─────────────┴─────────────┼─────────────┼─────────────┤ ├─────────────┼─────────────┼─────────────┴───────────────────────────╯
                                              &spc_morph    &kp LCTRL   ,   HYPER_RET     &smart_shft
//                                          ╰─────────────┴─────────────╯ ╰─────────────┴─────────────╯
)

ZMK_BASE_LAYER(nav,
//╭─────────────┬─────────────┬─────────────┬─────────────┬─────────────╮ ╭─────────────┬─────────────┬─────────────┬─────────────┬─────────────╮
    &kp LS(TAB)   &swapper      &kp UP        &app_swapper  ___         ,   &kp PG_UP     &kp LG(LS(N2)) &kp LG(LS(N3)) &kp LG(LS(N4)) NAV_BSPC ,
//├─────────────┼─────────────┼─────────────┼─────────────┼─────────────┤ ├─────────────┼─────────────┼─────────────┼─────────────┼─────────────┤
    &out OUT_USB  &kp LEFT      &kp DOWN      &kp RIGHT     &kp LC(LA(SPACE)), &kp PG_DN   &sk LGUI      &sk LCTRL     &sk LALT      &sk LSHFT ,
//├─────────────┼─────────────┼─────────────┼─────────────┼─────────────┤ ├─────────────┼─────────────┼─────────────┼─────────────┼─────────────┤
    &kp LG(Z)     &kp LG(X)     &kp LG(C)     &kp LG(V)     &kp LG(LS(V)), &kp INS       &kp TAB       &kp LT        &kp GT        ___ ,
//╰─────────────┼─────────────┴─────────────┼─────────────┼─────────────┤ ├─────────────┼─────────────┼─────────────┴───────────────────────────╯
                                              ___           ___         ,   ___           CANCEL
//                                          ╰─────────────┴─────────────╯ ╰─────────────┴─────────────╯
)

ZMK_BASE_LAYER(fn,
//╭─────────────┬─────────────┬─────────────┬─────────────┬─────────────╮ ╭─────────────┬─────────────┬─────────────┬─────────────┬─────────────╮
    &kp F12       &kp F7        &kp F8        &kp F9        ___         ,   ___           &kp C_PREV    &kp C_VOL_UP  &kp C_NEXT    &win_sleep  ,
//├─────────────┼─────────────┼─────────────┼─────────────┼─────────────┤ ├─────────────┼─────────────┼─────────────┼─────────────┼─────────────┤
    &hml LGUI F11 &hml LALT F4  &hml LSHFT F5 &hml LCTRL F6 ___         ,   ___           DSK_PREV      VOL_DOWN      DSK_NEXT      ___         ,
//├─────────────┼─────────────┼─────────────┼─────────────┼─────────────┤ ├─────────────┼─────────────┼─────────────┼─────────────┼─────────────┤
    &kp F10       &kp F1        &kp F2        &kp F3        ___         ,   PIN_APP       PIN_WIN       DSK_MGR       ___           ___         ,
//╰─────────────┼─────────────┴─────────────┼─────────────┼─────────────┤ ├─────────────┼─────────────┼─────────────┴───────────────────────────╯
                                              ___           ___         ,   &kp C_MUTE    &kp C_PP
//                                          ╰─────────────┴─────────────╯ ╰─────────────┴─────────────╯
)

ZMK_BASE_LAYER(num,
//╭─────────────┬─────────────┬─────────────┬─────────────┬─────────────╮ ╭─────────────┬─────────────┬─────────────┬─────────────┬─────────────╮
    ___           ___           ___           ___           ___         ,   ___           &kp N7        &kp N8        &kp N9        ___         ,
//├─────────────┼─────────────┼─────────────┼─────────────┼─────────────┤ ├─────────────┼─────────────┼─────────────┼─────────────┼─────────────┤
    ___           ___           ___           ___           ___         ,   ___           &kp N4        &kp N5        &kp N6        &kp N0      ,
//├─────────────┼─────────────┼─────────────┼─────────────┼─────────────┤ ├─────────────┼─────────────┼─────────────┼─────────────┼─────────────┤
    ___           ___           ___           ___           ___         ,   ___           &kp N1        &kp N2        &kp N3        ___         ,
//╰─────────────┼─────────────┴─────────────┼─────────────┼─────────────┤ ├─────────────┼─────────────┼─────────────┴───────────────────────────╯
                                              ___           ___         ,   ___           CANCEL
//                                          ╰─────────────┴─────────────╯ ╰─────────────┴─────────────╯
)

ZMK_BASE_LAYER(sys,
//╭─────────────┬─────────────┬─────────────┬─────────────┬─────────────╮ ╭─────────────┬─────────────┬─────────────┬─────────────┬─────────────╮
    _BT_SEL_KEYS_                                                        ,   ___           ___           ___           ___           ___         ,
//├─────────────┼─────────────┼─────────────┼─────────────┼─────────────┤ ├─────────────┼─────────────┼─────────────┼─────────────┼─────────────┤
    ___           ___           ___           ___           &bootloader ,   &bootloader   ___           ___           ___           ___         ,
//├─────────────┼─────────────┼─────────────┼─────────────┼─────────────┤ ├─────────────┼─────────────┼─────────────┼─────────────┼─────────────┤
    ___           ___           ___           ___           &sys_reset  ,   &sys_reset    ___           ___           ___           ___         ,
//╰─────────────┼─────────────┴─────────────┼─────────────┼─────────────┤ ├─────────────┼─────────────┼─────────────┴───────────────────────────╯
                                              ___           ___         ,   &to 0         ___
//                                          ╰─────────────┴─────────────╯ ╰─────────────┴─────────────╯
)
